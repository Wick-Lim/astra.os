## Config.in
```kconfig
# ASTRA.OS External Packages

menu "ASTRA.OS packages"
    source "$BR2_EXTERNAL_ASTRA_PATH/packages/servo/Config.in"
endmenu
```

## configs/astra_defconfig
```kconfig
# ASTRA.OS Buildroot Configuration
# Phase 1+2: Bootable system with graphics stack

# Architecture
BR2_x86_64=y

# Toolchain
BR2_TOOLCHAIN_BUILDROOT_MUSL=y
BR2_TOOLCHAIN_BUILDROOT_CXX=y

# Kernel
BR2_LINUX_KERNEL=y
BR2_LINUX_KERNEL_CUSTOM_VERSION=y
BR2_LINUX_KERNEL_CUSTOM_VERSION_VALUE="6.6.70"
BR2_LINUX_KERNEL_USE_CUSTOM_CONFIG=y
BR2_LINUX_KERNEL_CUSTOM_CONFIG_FILE="$(BR2_EXTERNAL_ASTRA_PATH)/configs/linux.config"
BR2_LINUX_KERNEL_INSTALL_TARGET=y

# Filesystem
BR2_TARGET_ROOTFS_EXT2=y
BR2_TARGET_ROOTFS_EXT2_4=y
BR2_TARGET_ROOTFS_EXT2_SIZE="512M"
BR2_TARGET_ROOTFS_EXT2_MKFS_OPTIONS="-O ^metadata_csum"

# Root filesystem overlay
BR2_ROOTFS_OVERLAY="$(BR2_EXTERNAL_ASTRA_PATH)/overlay"

# System
BR2_TARGET_GENERIC_HOSTNAME="astra"
BR2_TARGET_GENERIC_ISSUE="Welcome to ASTRA.OS"
BR2_SYSTEM_DHCP="eth0"
BR2_TARGET_GENERIC_ROOT_PASSWD="astra"
BR2_SYSTEM_DEFAULT_PATH="/bin:/sbin:/usr/bin:/usr/sbin"

# Init system
BR2_INIT_BUSYBOX=y

# Shell
BR2_SYSTEM_BIN_SH_BUSYBOX=y

# /dev management
BR2_ROOTFS_DEVICE_CREATION_DYNAMIC_EUDEV=y

# Core packages
BR2_PACKAGE_BUSYBOX=y
BR2_PACKAGE_BUSYBOX_SHOW_OTHERS=y

# Utilities
BR2_PACKAGE_UTIL_LINUX=y
BR2_PACKAGE_UTIL_LINUX_BINARIES=y
BR2_PACKAGE_KMOD=y
BR2_PACKAGE_KMOD_TOOLS=y

# ===========================================
# GRAPHICS STACK (Phase 2)
# ===========================================

# GPU Firmware
BR2_PACKAGE_LINUX_FIRMWARE=y
BR2_PACKAGE_LINUX_FIRMWARE_AMDGPU=y
BR2_PACKAGE_LINUX_FIRMWARE_I915=y
BR2_PACKAGE_LINUX_FIRMWARE_RADEON=y

# DRM/KMS
BR2_PACKAGE_LIBDRM=y
BR2_PACKAGE_LIBDRM_INTEL=y
BR2_PACKAGE_LIBDRM_RADEON=y
BR2_PACKAGE_LIBDRM_AMDGPU=y
BR2_PACKAGE_LIBDRM_NOUVEAU=y
BR2_PACKAGE_LIBDRM_INSTALL_TESTS=y

# Mesa (OpenGL/Vulkan)
BR2_PACKAGE_MESA3D=y
BR2_PACKAGE_MESA3D_GALLIUM_DRIVER_IRIS=y
BR2_PACKAGE_MESA3D_GALLIUM_DRIVER_NOUVEAU=y
BR2_PACKAGE_MESA3D_GALLIUM_DRIVER_RADEONSI=y
BR2_PACKAGE_MESA3D_GALLIUM_DRIVER_VIRGL=y
BR2_PACKAGE_MESA3D_GALLIUM_DRIVER_SWRAST=y
BR2_PACKAGE_MESA3D_VULKAN_DRIVER_INTEL=y
BR2_PACKAGE_MESA3D_VULKAN_DRIVER_RADEON=y
BR2_PACKAGE_MESA3D_OPENGL_EGL=y
BR2_PACKAGE_MESA3D_OPENGL_ES=y

# Wayland
BR2_PACKAGE_WAYLAND=y
BR2_PACKAGE_WAYLAND_PROTOCOLS=y

# Wayland compositor (Cage - kiosk mode)
BR2_PACKAGE_CAGE=y
BR2_PACKAGE_WLROOTS=y

# Input
BR2_PACKAGE_LIBINPUT=y
BR2_PACKAGE_LIBXKBCOMMON=y
BR2_PACKAGE_XKB_CONFIG=y

# Font rendering
BR2_PACKAGE_FONTCONFIG=y
BR2_PACKAGE_FREETYPE=y
BR2_PACKAGE_DEJAVU=y

# Terminal emulator for testing
BR2_PACKAGE_FOOT=y

# Pixel manipulation
BR2_PACKAGE_PIXMAN=y

# PNG/JPEG support
BR2_PACKAGE_LIBPNG=y
BR2_PACKAGE_JPEG=y

# ===========================================
# NETWORKING
# ===========================================
BR2_PACKAGE_DHCPCD=y
BR2_PACKAGE_OPENSSL=y
BR2_PACKAGE_CA_CERTIFICATES=y
BR2_PACKAGE_CURL=y

# ===========================================
# DEBUG/DEVELOPMENT (optional, can remove later)
# ===========================================
BR2_PACKAGE_STRACE=y
BR2_PACKAGE_HTOP=y

# External packages path
BR2_EXTERNAL="$(TOPDIR)/../"
```
